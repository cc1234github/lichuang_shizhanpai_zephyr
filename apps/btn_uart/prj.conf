## CMakeLists.txt
```
#-------------------------------------------------------------------------------
# Zephyr Example Application
#
# Copyright (c) 2021 Nordic Semiconductor ASA
# SPDX-License-Identifier: Apache-2.0

cmake_minimum_required(VERSION 3.13.1)

set(SDK_ROOT_PATH   ${CMAKE_CURRENT_SOURCE_DIR}/../..)
list(APPEND BOARD_ROOT ${SDK_ROOT_PATH}) 
set(SNIPPET_ROOT    ${SDK_ROOT_PATH}/boards)

# set(BOARD lc_shizhanpai) 

find_package(Zephyr REQUIRED HINTS $ENV{ZEPHYR_BASE})   

project(btn_uart)                             
target_sources(app PRIVATE 
        src/main.c)                  
```

## sample.yaml
```
# This file is provided so that the application can be compiled using Twister,
# the Zephyr testing tool. In this file, multiple combinations can be specified,
# so that you can easily test all of them locally or in CI.
sample:
  description: Example application
  name: example-application 
common:
  build_only: true
  integration_platforms:
    - custom_plank
    - nucleo_f302r8
tests:
  app.default: {}
  app.debug:
    extra_overlay_confs:
      - debug.conf
```

## prj.conf
```kconfig
# General Config
CONFIG_MAIN_STACK_SIZE=4096
CONFIG_CONSOLE=y
CONFIG_LOG=y
CONFIG_SHELL=y

# Device Config
CONFIG_GPIO=y
CONFIG_INPUT=y
```

## debug.conf
```kconfig
# Copyright (c) 2021 Nordic Semiconductor ASA
# SPDX-License-Identifier: Apache-2.0
#
# This is a Kconfig fragment which can be used to enable debug-related options
# in the application. See the README for more details.

# compiler 
CONFIG_DEBUG_OPTIMIZATIONS=y # 编译优化等级 (0)

# logging
CONFIG_LOG=y
CONFIG_APP_LOG_LEVEL_DBG=y
```

## app.overlay
```dts
/ {
	aliases {
		sw2 = &button0;
	};

	buttons {
		compatible = "gpio-keys";
		button0: button_0 {
			gpios = <&gpio0 0 (GPIO_PULL_UP | GPIO_ACTIVE_HIGH)>;
			label = "BOOT Button";
			zephyr,code = <INPUT_KEY_0>;
		};
	};
};
```

## src/main.c
```c
#include <zephyr/kernel.h>
#include <zephyr/device.h>
#include <zephyr/drivers/gpio.h>
#include <zephyr/devicetree.h>
#include <zephyr/sys/printk.h>
#include <zephyr/logging/log.h>

LOG_MODULE_REGISTER(Button, LOG_LEVEL_INF);

/*
 * Get button configuration from the devicetree sw2 alias. This is mandatory.
 */
#define SW2_NODE   DT_ALIAS(sw2)

#if !DT_NODE_HAS_STATUS_OKAY(SW2_NODE)
#error "Unsupported board: sw0 devicetree alias is not defined"
#endif

static const struct gpio_dt_spec button = GPIO_DT_SPEC_GET_OR(SW2_NODE, gpios,{0});
static struct gpio_callback button_cb_data;

void button_pressed(const struct device *dev, struct gpio_callback *cb,
            uint32_t pins)
{
    int val = gpio_pin_get(dev, button.pin);  
    LOG_INF("Button interrupt! pin=%s.%d, level=%d, time=%" PRIu32,
            button.port->name, button.pin, val, k_cycle_get_32());
}

int main(void)
{
    int ret;

    if (!gpio_is_ready_dt(&button)) {
        LOG_INF("Error: button device %s is not ready\n", button.port->name);
        return 0;
    }

    ret = gpio_pin_interrupt_configure_dt(&button, GPIO_INT_EDGE_BOTH);
    if (ret != 0) {
        LOG_INF("Error %d: failed to configure interrupt on %s pin %d\n",
            ret, button.port->name, button.pin);
        return 0;
    }

    gpio_init_callback(&button_cb_data, button_pressed, BIT(button.pin));
    gpio_add_callback(button.port, &button_cb_data);

    LOG_INF("Set up button at %s pin %d\n", button.port->name, button.pin);

    while (1) {
        k_msleep(1);
    }
}


/**************************************************************************
 * \brief 

1. 进入工作目录
cd /home/c/workspace/lc_shizhanpai_zephyr/apps/btn_uart

2. 初次构建
west build -p always -b lc_shizhanpai/esp32s3/procpu -d build .

3. 再次编译
west build -b lc_shizhanpai/esp32s3/procpu -d build .

4. 烧录
west flash -d build

6. 工具
west espressif monitor
west build -t menuconfig
west build -t guiconfig

west build -t initlevels
**************************************************************************/
```
