## boards/espressif/lc_shizhanpai/board.yml
```yaml
board:
  name: lc_shizhanpai     
  full_name: lichuang_shizhanpai_esp32s3
  vendor: espressif
  socs:
  - name: esp32s3
```

## boards/vendor/lc_szp/board.yml
```yaml
board:
  name: lc_szp
  full_name: lc_shizhanpai_esp32s3
  vendor: espressif
  socs:
  - name: esp32s3
```
