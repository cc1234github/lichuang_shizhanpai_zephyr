## apps/lvgl_display/build/build_esp32/Kconfig/Kconfig.modules
```kconfig
menu "acpica (/opt/toolchains/modules/lib/acpica)"
osource "$(ZEPHYR_ACPICA_KCONFIG)"
config ZEPHYR_ACPICA_MODULE
	bool
	default y
endmenu
menu "cmsis (/opt/toolchains/modules/hal/cmsis)"
osource "$(ZEPHYR_CMSIS_KCONFIG)"
config ZEPHYR_CMSIS_MODULE
	bool
	default y
endmenu
menu "cmsis-dsp (/opt/toolchains/modules/lib/cmsis-dsp)"
osource "$(ZEPHYR_CMSIS_DSP_KCONFIG)"
config ZEPHYR_CMSIS_DSP_MODULE
	bool
	default y
endmenu
menu "cmsis-nn (/opt/toolchains/modules/lib/cmsis-nn)"
osource "$(ZEPHYR_CMSIS_NN_KCONFIG)"
config ZEPHYR_CMSIS_NN_MODULE
	bool
	default y
endmenu
menu "cmsis_6 (/opt/toolchains/modules/hal/cmsis_6)"
osource "$(ZEPHYR_CMSIS_6_KCONFIG)"
config ZEPHYR_CMSIS_6_MODULE
	bool
	default y
endmenu
menu "fatfs (/opt/toolchains/modules/fs/fatfs)"
osource "$(ZEPHYR_FATFS_KCONFIG)"
config ZEPHYR_FATFS_MODULE
	bool
	default y
endmenu
config ZEPHYR_ADI_MODULE
	bool
	default y
menu "hal_afbr (/opt/toolchains/modules/hal/afbr)"
osource "$(ZEPHYR_HAL_AFBR_KCONFIG)"
config ZEPHYR_HAL_AFBR_MODULE
	bool
	default y

config ZEPHYR_HAL_AFBR_MODULE_BLOBS
	bool
endmenu
menu "hal_ambiq (/opt/toolchains/modules/hal/ambiq)"
osource "$(ZEPHYR_HAL_AMBIQ_KCONFIG)"
config ZEPHYR_HAL_AMBIQ_MODULE
	bool
	default y
endmenu
config ZEPHYR_ATMEL_MODULE
	bool
	default y
menu "hal_bouffalolab (/opt/toolchains/modules/hal/bouffalolab)"
osource "$(ZEPHYR_HAL_BOUFFALOLAB_KCONFIG)"
config ZEPHYR_HAL_BOUFFALOLAB_MODULE
	bool
	default y
endmenu
menu "hal_espressif (/opt/toolchains/modules/hal/espressif)"
osource "/opt/toolchains/modules/hal/espressif/zephyr/Kconfig"
config ZEPHYR_HAL_ESPRESSIF_MODULE
	bool
	default y

config ZEPHYR_HAL_ESPRESSIF_MODULE_BLOBS
	bool
endmenu
menu "hal_ethos_u (/opt/toolchains/modules/hal/ethos_u)"
osource "$(ZEPHYR_HAL_ETHOS_U_KCONFIG)"
config ZEPHYR_HAL_ETHOS_U_MODULE
	bool
	default y
endmenu
menu "hal_gigadevice (/opt/toolchains/modules/hal/gigadevice)"
osource "$(ZEPHYR_HAL_GIGADEVICE_KCONFIG)"
config ZEPHYR_HAL_GIGADEVICE_MODULE
	bool
	default y
endmenu
menu "hal_infineon (/opt/toolchains/modules/hal/infineon)"
osource "$(ZEPHYR_HAL_INFINEON_KCONFIG)"
config ZEPHYR_HAL_INFINEON_MODULE
	bool
	default y

config ZEPHYR_HAL_INFINEON_MODULE_BLOBS
	bool
endmenu
menu "hal_intel (/opt/toolchains/modules/hal/intel)"
osource "/opt/toolchains/modules/hal/intel/zephyr/Kconfig"
config ZEPHYR_HAL_INTEL_MODULE
	bool
	default y
endmenu
config ZEPHYR_MICROCHIP_MODULE
	bool
	default y
menu "hal_nordic (/opt/toolchains/modules/hal/nordic)"
osource "$(ZEPHYR_HAL_NORDIC_KCONFIG)"
config ZEPHYR_HAL_NORDIC_MODULE
	bool
	default y

config ZEPHYR_HAL_NORDIC_MODULE_BLOBS
	bool
endmenu
config ZEPHYR_NUVOTON_MODULE
	bool
	default y
menu "hal_nxp (/opt/toolchains/modules/hal/nxp)"
osource "$(ZEPHYR_HAL_NXP_KCONFIG)"
config ZEPHYR_HAL_NXP_MODULE
	bool
	default y

config ZEPHYR_HAL_NXP_MODULE_BLOBS
	bool
endmenu
config ZEPHYR_OPENISA_MODULE
	bool
	default y
config ZEPHYR_QUICKLOGIC_MODULE
	bool
	default y
config ZEPHYR_HAL_RENESAS_MODULE
	bool
	default y

config ZEPHYR_HAL_RENESAS_MODULE_BLOBS
	bool
menu "hal_rpi_pico (/opt/toolchains/modules/hal/rpi_pico)"
osource "$(ZEPHYR_HAL_RPI_PICO_KCONFIG)"
config ZEPHYR_HAL_RPI_PICO_MODULE
	bool
	default y
endmenu
menu "hal_sifli (/opt/toolchains/modules/hal/sifli)"
osource "$(ZEPHYR_HAL_SIFLI_KCONFIG)"
config ZEPHYR_HAL_SIFLI_MODULE
	bool
	default y
endmenu
menu "hal_silabs (/opt/toolchains/modules/hal/silabs)"
osource "$(ZEPHYR_HAL_SILABS_KCONFIG)"
config ZEPHYR_HAL_SILABS_MODULE
	bool
	default y

config ZEPHYR_HAL_SILABS_MODULE_BLOBS
	bool
endmenu
menu "hal_st (/opt/toolchains/modules/hal/st)"
osource "$(ZEPHYR_HAL_ST_KCONFIG)"
config ZEPHYR_HAL_ST_MODULE
	bool
	default y
endmenu
config ZEPHYR_HAL_STM32_MODULE
	bool
	default y

config ZEPHYR_HAL_STM32_MODULE_BLOBS
	bool
menu "hal_tdk (/opt/toolchains/modules/hal/tdk)"
osource "$(ZEPHYR_HAL_TDK_KCONFIG)"
config ZEPHYR_HAL_TDK_MODULE
	bool
	default y
endmenu
menu "hal_telink (/opt/toolchains/modules/hal/telink)"
osource "/opt/toolchains/modules/hal/telink/Kconfig"
config ZEPHYR_HAL_TELINK_MODULE
	bool
	default y
endmenu
config ZEPHYR_TI_MODULE
	bool
	default y
menu "hal_wch (/opt/toolchains/modules/hal/wch)"
osource "$(ZEPHYR_HAL_WCH_KCONFIG)"
config ZEPHYR_HAL_WCH_MODULE
	bool
	default y
endmenu
config ZEPHYR_HAL_WURTHELEKTRONIK_MODULE
	bool
	default y
config ZEPHYR_XTENSA_MODULE
	bool
	default y
menu "hostap (/opt/toolchains/modules/lib/hostap)"
osource "$(ZEPHYR_HOSTAP_KCONFIG)"
config ZEPHYR_HOSTAP_MODULE
	bool
	default y
endmenu
menu "liblc3 (/opt/toolchains/modules/lib/liblc3)"
osource "$(ZEPHYR_LIBLC3_KCONFIG)"
config ZEPHYR_LIBLC3_MODULE
	bool
	default y
endmenu
config ZEPHYR_LIBMCTP_MODULE
	bool
	default y
config ZEPHYR_LIBMETAL_MODULE
	bool
	default y
menu "libsbc (/opt/toolchains/modules/lib/libsbc)"
osource "$(ZEPHYR_LIBSBC_KCONFIG)"
config ZEPHYR_LIBSBC_MODULE
	bool
	default y
endmenu
menu "littlefs (/opt/toolchains/modules/fs/littlefs)"
osource "$(ZEPHYR_LITTLEFS_KCONFIG)"
config ZEPHYR_LITTLEFS_MODULE
	bool
	default y
endmenu
menu "lora-basics-modem (/opt/toolchains/modules/lib/lora-basics-modem)"
osource "$(ZEPHYR_LORA_BASICS_MODEM_KCONFIG)"
config ZEPHYR_LORA_BASICS_MODEM_MODULE
	bool
	default y
endmenu
menu "loramac-node (/opt/toolchains/modules/lib/loramac-node)"
osource "$(ZEPHYR_LORAMAC_NODE_KCONFIG)"
config ZEPHYR_LORAMAC_NODE_MODULE
	bool
	default y
endmenu
menu "lvgl (/opt/toolchains/modules/lib/gui/lvgl)"
osource "/opt/toolchains/modules/lib/gui/lvgl/zephyr/Kconfig"
config ZEPHYR_LVGL_MODULE
	bool
	default y
endmenu
menu "mbedtls (/opt/toolchains/modules/crypto/mbedtls)"
osource "$(ZEPHYR_MBEDTLS_KCONFIG)"
config ZEPHYR_MBEDTLS_MODULE
	bool
	default y
endmenu
config ZEPHYR_MCUBOOT_MODULE
	bool
	default y
config ZEPHYR_MIPI_SYS_T_MODULE
	bool
	default y
menu "nanopb (/opt/toolchains/modules/lib/nanopb)"
osource "$(ZEPHYR_NANOPB_KCONFIG)"
config ZEPHYR_NANOPB_MODULE
	bool
	default y
endmenu
menu "nrf_wifi (/opt/toolchains/modules/lib/nrf_wifi)"
osource "$(ZEPHYR_NRF_WIFI_KCONFIG)"
config ZEPHYR_NRF_WIFI_MODULE
	bool
	default y

config ZEPHYR_NRF_WIFI_MODULE_BLOBS
	bool
endmenu
config ZEPHYR_OPEN_AMP_MODULE
	bool
	default y
menu "openthread (/opt/toolchains/modules/lib/openthread)"
osource "$(ZEPHYR_OPENTHREAD_KCONFIG)"
config ZEPHYR_OPENTHREAD_MODULE
	bool
	default y
endmenu
menu "percepio (/opt/toolchains/modules/debug/percepio)"
osource "/opt/toolchains/modules/debug/percepio/zephyr/Kconfig"
config ZEPHYR_PERCEPIO_MODULE
	bool
	default y
endmenu
menu "picolibc (/opt/toolchains/modules/lib/picolibc)"
osource "/opt/toolchains/modules/lib/picolibc/zephyr/Kconfig"
config ZEPHYR_PICOLIBC_MODULE
	bool
	default y
endmenu
menu "segger (/opt/toolchains/modules/debug/segger)"
osource "$(ZEPHYR_SEGGER_KCONFIG)"
config ZEPHYR_SEGGER_MODULE
	bool
	default y
endmenu
menu "trusted-firmware-a (/opt/toolchains/modules/tee/tf-a/trusted-firmware-a)"
osource "$(ZEPHYR_TRUSTED_FIRMWARE_A_KCONFIG)"
config ZEPHYR_TRUSTED_FIRMWARE_A_MODULE
	bool
	default y
endmenu
menu "trusted-firmware-m (/opt/toolchains/modules/tee/tf-m/trusted-firmware-m)"
osource "$(ZEPHYR_TRUSTED_FIRMWARE_M_KCONFIG)"
config ZEPHYR_TRUSTED_FIRMWARE_M_MODULE
	bool
	default y
endmenu
menu "uoscore-uedhoc (/opt/toolchains/modules/lib/uoscore-uedhoc)"
osource "$(ZEPHYR_UOSCORE_UEDHOC_KCONFIG)"
config ZEPHYR_UOSCORE_UEDHOC_MODULE
	bool
	default y
endmenu
menu "zcbor (/opt/toolchains/modules/lib/zcbor)"
osource "$(ZEPHYR_ZCBOR_KCONFIG)"
config ZEPHYR_ZCBOR_MODULE
	bool
	default y
endmenu
config ZEPHYR_NRF_HW_MODELS_MODULE
	bool
	default y
```

## apps/lvgl_display/build/build_esp32/Kconfig/Kconfig.shield.defconfig
```kconfig
osource "/home/c/workspace/lc_shizhanpai_zephyr/apps/lvgl_display/../../boards/shields/*/Kconfig.defconfig"
```

## apps/lvgl_display/build/build_esp32/Kconfig/arch/Kconfig
```kconfig
# Load Zephyr Arch Kconfig descriptions.
osource "/opt/toolchains/zephyr/arch/rx/Kconfig"
osource "/opt/toolchains/zephyr/arch/x86/Kconfig"
osource "/opt/toolchains/zephyr/arch/xtensa/Kconfig"
osource "/opt/toolchains/zephyr/arch/sparc/Kconfig"
osource "/opt/toolchains/zephyr/arch/riscv/Kconfig"
osource "/opt/toolchains/zephyr/arch/posix/Kconfig"
osource "/opt/toolchains/zephyr/arch/mips/Kconfig"
osource "/opt/toolchains/zephyr/arch/arm64/Kconfig"
osource "/opt/toolchains/zephyr/arch/arm/Kconfig"
osource "/opt/toolchains/zephyr/arch/arc/Kconfig"
```

## apps/lvgl_display/build/build_esp32/Kconfig/boards/Kconfig
```kconfig
# Load Zephyr board Kconfig descriptions.
osource "/home/c/workspace/lc_shizhanpai_zephyr/boards/espressif/lc_shizhanpai/Kconfig"
```

## apps/lvgl_display/build/build_esp32/Kconfig/boards/Kconfig.defconfig
```kconfig
# Load Zephyr board defconfig descriptions.
osource "/home/c/workspace/lc_shizhanpai_zephyr/boards/espressif/lc_shizhanpai/Kconfig.defconfig"
```

## apps/lvgl_display/build/build_esp32/Kconfig/boards/Kconfig.lc_shizhanpai
```kconfig
# Load board Kconfig descriptions.
osource "/home/c/workspace/lc_shizhanpai_zephyr/boards/espressif/lc_shizhanpai/Kconfig.lc_shizhanpai"
```

## apps/lvgl_display/build/build_esp32/Kconfig/boards/Kconfig.sysbuild
```kconfig
# Load Sysbuild board Kconfig descriptions.
osource "/home/c/workspace/lc_shizhanpai_zephyr/boards/espressif/lc_shizhanpai/Kconfig.sysbuild"
```

## apps/lvgl_display/build/build_esp32/Kconfig/soc/Kconfig
```kconfig
# Load Zephyr SoC Kconfig descriptions.
osource "/opt/toolchains/zephyr/soc/xlnx/zynqmp/Kconfig"
osource "/opt/toolchains/zephyr/soc/xlnx/zynq7000/Kconfig"
osource "/opt/toolchains/zephyr/soc/xlnx/versalnet/Kconfig"
osource "/opt/toolchains/zephyr/soc/xlnx/versal2/Kconfig"
osource "/opt/toolchains/zephyr/soc/xen/Kconfig"
osource "/opt/toolchains/zephyr/soc/wch/ch32v/Kconfig"
osource "/opt/toolchains/zephyr/soc/ti/simplelink/Kconfig"
osource "/opt/toolchains/zephyr/soc/ti/mspm0/Kconfig"
osource "/opt/toolchains/zephyr/soc/ti/lm3s6965/Kconfig"
osource "/opt/toolchains/zephyr/soc/ti/k3/Kconfig"
osource "/opt/toolchains/zephyr/soc/telink/tlsr/Kconfig"
osource "/opt/toolchains/zephyr/soc/starfive/jh71xx/Kconfig"
osource "/opt/toolchains/zephyr/soc/st/stm32/Kconfig"
osource "/opt/toolchains/zephyr/soc/snps/qemu_arc/Kconfig"
osource "/opt/toolchains/zephyr/soc/snps/nsim/arc_v/Kconfig"
osource "/opt/toolchains/zephyr/soc/snps/nsim/arc_classic/Kconfig"
osource "/opt/toolchains/zephyr/soc/snps/hsdk4xd/Kconfig"
osource "/opt/toolchains/zephyr/soc/snps/hsdk/Kconfig"
osource "/opt/toolchains/zephyr/soc/snps/emsk/Kconfig"
osource "/opt/toolchains/zephyr/soc/snps/emsdp/Kconfig"
osource "/opt/toolchains/zephyr/soc/snps/arc_iot/Kconfig"
osource "/opt/toolchains/zephyr/soc/silabs/Kconfig"
osource "/opt/toolchains/zephyr/soc/sifli/sf32/Kconfig"
osource "/opt/toolchains/zephyr/soc/sifive/sifive_freedom/Kconfig"
osource "/opt/toolchains/zephyr/soc/sensry/Kconfig"
osource "/opt/toolchains/zephyr/soc/rockchip/Kconfig"
osource "/opt/toolchains/zephyr/soc/renode/riscv_virtual/Kconfig"
osource "/opt/toolchains/zephyr/soc/renode/cortex_r8_virtual/Kconfig"
osource "/opt/toolchains/zephyr/soc/renesas/smartbond/Kconfig"
osource "/opt/toolchains/zephyr/soc/renesas/rz/Kconfig"
osource "/opt/toolchains/zephyr/soc/renesas/rx/Kconfig"
osource "/opt/toolchains/zephyr/soc/renesas/rcar/Kconfig"
osource "/opt/toolchains/zephyr/soc/renesas/ra/Kconfig"
osource "/opt/toolchains/zephyr/soc/realtek/ec/Kconfig"
osource "/opt/toolchains/zephyr/soc/raspberrypi/rpi_pico/Kconfig"
osource "/opt/toolchains/zephyr/soc/quicklogic/eos_s3/Kconfig"
osource "/opt/toolchains/zephyr/soc/qemu/virt_riscv/Kconfig"
osource "/opt/toolchains/zephyr/soc/qemu/malta/Kconfig"
osource "/opt/toolchains/zephyr/soc/openisa/rv32m1/Kconfig"
osource "/opt/toolchains/zephyr/soc/openhwgroup/cva6/Kconfig"
osource "/opt/toolchains/zephyr/soc/oct/osd32mp15x/Kconfig"
osource "/opt/toolchains/zephyr/soc/nxp/s32/Kconfig"
osource "/opt/toolchains/zephyr/soc/nxp/rw/Kconfig"
osource "/opt/toolchains/zephyr/soc/nxp/mcx/Kconfig"
osource "/opt/toolchains/zephyr/soc/nxp/lpc/Kconfig"
osource "/opt/toolchains/zephyr/soc/nxp/layerscape/Kconfig"
osource "/opt/toolchains/zephyr/soc/nxp/kinetis/Kconfig"
osource "/opt/toolchains/zephyr/soc/nxp/imxrt/Kconfig"
osource "/opt/toolchains/zephyr/soc/nxp/imx/Kconfig"
osource "/opt/toolchains/zephyr/soc/nuvoton/numicro/Kconfig"
osource "/opt/toolchains/zephyr/soc/nuvoton/numaker/Kconfig"
osource "/opt/toolchains/zephyr/soc/nuvoton/npcx/Kconfig"
osource "/opt/toolchains/zephyr/soc/nuvoton/npcm/Kconfig"
osource "/opt/toolchains/zephyr/soc/nordic/Kconfig"
osource "/opt/toolchains/zephyr/soc/neorv32/Kconfig"
osource "/opt/toolchains/zephyr/soc/native/inf_clock/Kconfig"
osource "/opt/toolchains/zephyr/soc/microchip/sam/Kconfig"
osource "/opt/toolchains/zephyr/soc/microchip/sam/sam_d5x_e5x/Kconfig"
osource "/opt/toolchains/zephyr/soc/microchip/pic32c/pic32cm_jh/Kconfig"
osource "/opt/toolchains/zephyr/soc/microchip/miv/Kconfig"
osource "/opt/toolchains/zephyr/soc/microchip/mec/Kconfig"
osource "/opt/toolchains/zephyr/soc/mediatek/mt8xxx/Kconfig"
osource "/opt/toolchains/zephyr/soc/lowrisc/opentitan/Kconfig"
osource "/opt/toolchains/zephyr/soc/litex/litex_vexriscv/Kconfig"
osource "/opt/toolchains/zephyr/soc/ite/ec/Kconfig"
osource "/opt/toolchains/zephyr/soc/intel/raptor_lake/Kconfig"
osource "/opt/toolchains/zephyr/soc/intel/panther_lake/Kconfig"
osource "/opt/toolchains/zephyr/soc/intel/lakemont/Kconfig"
osource "/opt/toolchains/zephyr/soc/intel/intel_socfpga_std/Kconfig"
osource "/opt/toolchains/zephyr/soc/intel/intel_socfpga/Kconfig"
osource "/opt/toolchains/zephyr/soc/intel/intel_niosv/Kconfig"
osource "/opt/toolchains/zephyr/soc/intel/intel_ish/Kconfig"
osource "/opt/toolchains/zephyr/soc/intel/intel_adsp/Kconfig"
osource "/opt/toolchains/zephyr/soc/intel/elkhart_lake/Kconfig"
osource "/opt/toolchains/zephyr/soc/intel/atom/Kconfig"
osource "/opt/toolchains/zephyr/soc/intel/apollo_lake/Kconfig"
osource "/opt/toolchains/zephyr/soc/intel/alder_lake/Kconfig"
osource "/opt/toolchains/zephyr/soc/infineon/cat3/Kconfig"
osource "/opt/toolchains/zephyr/soc/infineon/cat1c/Kconfig"
osource "/opt/toolchains/zephyr/soc/infineon/cat1b/Kconfig"
osource "/opt/toolchains/zephyr/soc/infineon/cat1a/Kconfig"
osource "/opt/toolchains/zephyr/soc/gd/gd32/Kconfig"
osource "/opt/toolchains/zephyr/soc/gaisler/leon3/Kconfig"
osource "/opt/toolchains/zephyr/soc/gaisler/gr716a/Kconfig"
osource "/opt/toolchains/zephyr/soc/espressif/Kconfig"
osource "/opt/toolchains/zephyr/soc/ene/kb1200/Kconfig"
osource "/opt/toolchains/zephyr/soc/ene/kb106x/Kconfig"
osource "/opt/toolchains/zephyr/soc/efinix/sapphire/Kconfig"
osource "/opt/toolchains/zephyr/soc/cdns/xtensa_sample_controller/Kconfig"
osource "/opt/toolchains/zephyr/soc/cdns/sample_controller32/Kconfig"
osource "/opt/toolchains/zephyr/soc/cdns/dc233c/Kconfig"
osource "/opt/toolchains/zephyr/soc/brcm/bcmvk/Kconfig"
osource "/opt/toolchains/zephyr/soc/brcm/bcm2712/Kconfig"
osource "/opt/toolchains/zephyr/soc/brcm/bcm2711/Kconfig"
osource "/opt/toolchains/zephyr/soc/bflb/Kconfig"
osource "/opt/toolchains/zephyr/soc/atmel/sam0/Kconfig"
osource "/opt/toolchains/zephyr/soc/atmel/sam/Kconfig"
osource "/opt/toolchains/zephyr/soc/aspeed/Kconfig"
osource "/opt/toolchains/zephyr/soc/arm/Kconfig"
osource "/opt/toolchains/zephyr/soc/arm/beetle/Kconfig"
osource "/opt/toolchains/zephyr/soc/antmicro/myra/Kconfig"
osource "/opt/toolchains/zephyr/soc/andestech/Kconfig"
osource "/opt/toolchains/zephyr/soc/amd/acp_6_0/Kconfig"
osource "/opt/toolchains/zephyr/soc/ambiq/Kconfig"
osource "/opt/toolchains/zephyr/soc/aesc/Kconfig"
osource "/opt/toolchains/zephyr/soc/adi/max32/Kconfig"
```

## boards/espressif/lc_shizhanpai/Kconfig.lc_shizhanpai
```kconfig
# Copyright (c) 2022 Espressif Systems (Shanghai) Co., Ltd.
# SPDX-License-Identifier: Apache-2.0

config BOARD_LC_SHIZHANPAI
	select SOC_ESP32S3_WROOM_N16R8
	select SOC_ESP32S3_PROCPU if BOARD_LC_SHIZHANPAI_ESP32S3_PROCPU
	select SOC_ESP32S3_APPCPU if BOARD_LC_SHIZHANPAI_ESP32S3_APPCPU
```
